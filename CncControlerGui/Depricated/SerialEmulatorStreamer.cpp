#include <wx/file.h>
#include "SerialEmulatorBinaryStreamer.h"

///////////////////////////////////////////////////////////////////
SerialEmulatorStreamer::SerialEmulatorStreamer(CncControl* cnc)
: SerialEmulatorNULL(cnc) 
, CncBinaryTemplateStreamer()
, fileName("")
///////////////////////////////////////////////////////////////////
{
}
///////////////////////////////////////////////////////////////////
//Initialize Serial communication with the given COM port
SerialEmulatorStreamer::SerialEmulatorStreamer(const char *fileName)
: SerialEmulatorNULL(fileName) 
, CncBinaryTemplateStreamer()
, fileName("")
///////////////////////////////////////////////////////////////////
{
}
///////////////////////////////////////////////////////////////////
SerialEmulatorStreamer::~SerialEmulatorStreamer() {
///////////////////////////////////////////////////////////////////
}
///////////////////////////////////////////////////////////////////
bool SerialEmulatorStreamer::isOutputAsTemplateAvailable() { 
///////////////////////////////////////////////////////////////////
	if ( wxFile::Exists(getPortName()) == true )
		return true;
	
	return false; 
}
///////////////////////////////////////////////////////////////////
bool SerialEmulatorStreamer::connect(const char* fileName) {
///////////////////////////////////////////////////////////////////
	this->fileName.assign(fileName);
	
	setConnected(true);
	return isConnected();
}
///////////////////////////////////////////////////////////////////
void SerialEmulatorStreamer::disconnect(void) {
///////////////////////////////////////////////////////////////////
	setConnected(false);
}
///////////////////////////////////////////////////////////////////
bool SerialEmulatorStreamer::writeMoveRawCallback(unsigned char *buffer, unsigned int nbByte) {
///////////////////////////////////////////////////////////////////
	return appendDataBlock(buffer, nbByte);
}
///////////////////////////////////////////////////////////////////
bool SerialEmulatorStreamer::writeSetterRawCallback(unsigned char *buffer, unsigned int nbByte) {
///////////////////////////////////////////////////////////////////
	return appendDataBlock(buffer, nbByte);
}
///////////////////////////////////////////////////////////////////
void SerialEmulatorStreamer::processTrigger(const Serial::Trigger::BeginRun& tr) {
///////////////////////////////////////////////////////////////////
	if ( isReadyToStream() )
		finalize();
	
	CncBinaryTemplateStreamer::ParameterSet ps = tr.parameter;
	ps.fullFileName = fileName;
	
	if ( initNextSourceTemplateFileName(ps) == false) {
		std::cerr << "SerialEmulatorStreamer::processTrigger(BeginRun): initNextSourceTemplateFileName failed" << std::endl;
		disconnect();
	}
}
///////////////////////////////////////////////////////////////////
void SerialEmulatorStreamer::processTrigger(const Serial::Trigger::EndRun& tr) {
///////////////////////////////////////////////////////////////////
	if ( finalize() == false ) {
		std::cerr << "SerialEmulatorStreamer::processTrigger(TrEndRun): finalize() failed" << std::endl;
	}
}

